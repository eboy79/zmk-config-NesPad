## config/boards/shields/NesPad/Kconfig.defconfig
```kconfig
if SHIELD_NESPAD

config ZMK_KEYBOARD_NAME
    default "NesPad"

config USB_DEVICE_PRODUCT
    default "NesPad"

config USB_DEVICE_VID
    default 0x1D50

config USB_DEVICE_PID
    default 0x615E

config USB_DEVICE_MANUFACTURER
    default "ZMK Project"

config ZMK_RGB_UNDERGLOW
    bool "Enable RGB Underglow"
    default y

config ZMK_RGB_UNDERGLOW_BRT_START
    int "Starting Brightness (0-100)"
    default 50

config ZMK_RGB_UNDERGLOW_HUE_START
    int "Starting Hue (0-360)"
    default 150

config ZMK_RGB_UNDERGLOW_SAT_START
    int "Starting Saturation (0-100)"
    default 100

config ZMK_STUDIO
    bool "Enable ZMK Studio Support"
    default y

endif


menu "Output Types"

config ZMK_USB
    bool "USB"
    depends on (!ZMK_SPLIT || (ZMK_SPLIT && ZMK_SPLIT_ROLE_CENTRAL))
    select USB
    select USB_DEVICE_STACK
    select USB_DEVICE_HID

config ZMK_USB_BOOT
    bool "USB Boot Protocol Support"
    depends on ZMK_USB
    select USB_HID_BOOT_PROTOCOL
    select USB_DEVICE_SOF

if ZMK_USB

config USB_NUMOF_EP_WRITE_RETRIES
    default 10

config USB_HID_POLL_INTERVAL_MS
    default 1

endif # ZMK_USB
endmenu # Output Types
```
